## lyband/Kconfig
```kconfig
config LIANYUN_BAND
	bool "LIANYUN_BAND"
	default n
	---help---
	  Lianyun Band Driver

config LIANYUN_BAND_NEW
	bool "LIANYUN_BAND_NEW"
	default n
	---help---
	  Lianyun Band New Driver
```
